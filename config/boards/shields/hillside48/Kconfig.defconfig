## config/boards/shields/hillside48/Kconfig.defconfig
```kconfig
# Copyright (c) 2021 The ZMK Contributors
# SPDX-License-Identifier: MIT

if SHIELD_HILLSIDE48

config ZMK_KEYBOARD_NAME
    default "STITCH 626"

endif
```

## config/boards/shields/hillside48/Kconfig.shield
```kconfig
# Copyright (c) 2021 The ZMK Contributors
# SPDX-License-Identifier: MIT

config SHIELD_HILLSIDE48
    def_bool $(shields_list_contains,hillside48)
```

## config/west.yml
```yaml
manifest:
  remotes:
    - name: zmkfirmware
      url-base: https://github.com/zmkfirmware
    - name: infused-kim
      url-base: https://github.com/infused-kim
  projects:
    - name: zmk
      remote: zmkfirmware
      revision: main
      import: app/west.yml

    - name: kb_zmk_ps2_mouse_trackpoint_driver
      remote: infused-kim
      revision: main

  self:
    path: config
```
