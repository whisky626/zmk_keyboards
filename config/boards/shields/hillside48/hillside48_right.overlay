/*
 * Copyright (c) 2021 The ZMK Contributors
 *
 * SPDX-License-Identifier: MIT
 */

#include "hillside48.dtsi" 

&default_transform {
    col-offset = <5>;
};

&kscan0 {
        row-gpios
            = <&pro_micro 4 (GPIO_ACTIVE_HIGH | GPIO_PULL_DOWN)>
            , <&pro_micro 14 (GPIO_ACTIVE_HIGH | GPIO_PULL_DOWN)>
            , <&pro_micro 6 (GPIO_ACTIVE_HIGH | GPIO_PULL_DOWN)>
            , <&pro_micro 15 (GPIO_ACTIVE_HIGH | GPIO_PULL_DOWN)>
            ;

        col-gpios
        = <&pro_micro 8 GPIO_ACTIVE_HIGH> // col0 in the schematic
        , <&pro_micro 9 GPIO_ACTIVE_HIGH> // col1 in the schematic
        , <&pro_micro 18 GPIO_ACTIVE_HIGH> // col2 in the schematic
        , <&pro_micro 5 GPIO_ACTIVE_HIGH> // col3 in the schematic
        , <&pro_micro 21 GPIO_ACTIVE_HIGH> // col4 in the schematic
        ;
   };
